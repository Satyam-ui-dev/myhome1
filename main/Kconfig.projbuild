## main/Kconfig.projbuild
```kconfig
menu "Home Automation"

config HOME_WIFI_SSID
    string "Wi-Fi SSID"
    default ""

config HOME_WIFI_PASSWORD
    string "Wi-Fi password"
    default ""

endmenu
```
